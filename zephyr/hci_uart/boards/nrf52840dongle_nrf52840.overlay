/ {
  chosen {
    zephyr,bt-c2h-uart = &cdc_acm_uart;
    /delete-property/ zephyr,console;
    /delete-property/ zephyr,bt-mon-uart;
    /delete-property/ zephyr,uart-mcumgr;
    /delete-property/ zephyr,shell-uart;
  };
};

&cdc_acm_uart {
  hw-flow-control;
};
